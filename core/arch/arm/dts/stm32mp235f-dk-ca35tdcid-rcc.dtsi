// SPDX-License-Identifier: (GPL-2.0-only OR BSD-3-Clause)
/*
 * Copyright (C) STMicroelectronics 2022 - All Rights Reserved
 * Author: Loic Pallardy loic.pallardy@foss.st.com for STMicroelectronics.
 */

#include "stm32mp257f-dk-ca35tdcid-rcc.dtsi"
